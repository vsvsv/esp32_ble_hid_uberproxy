## sdkconfig.defaults
```kconfig
# ESP-IDF sdkconfig defaults for BLE HID Uberproxy
# Target: ESP32-S3

# ---- Bluetooth (Bluedroid BLE only, no Classic BT on S3) ----
CONFIG_BT_ENABLED=y
CONFIG_BT_BLUEDROID_ENABLED=y
CONFIG_BT_BLE_ENABLED=y
CONFIG_BT_BLE_42_FEATURES_SUPPORTED=y
CONFIG_BT_GATTC_NOTIF_REG_MAX=16

# ---- TinyUSB HID Device ----
CONFIG_TINYUSB_HID_COUNT=1

# ---- Partition table (large single app for BT + USB) ----
CONFIG_PARTITION_TABLE_SINGLE_APP_LARGE=y

# ---- Stack sizes (BLE + USB need headroom) ----
CONFIG_ESP_MAIN_TASK_STACK_SIZE=8192

# ---- Console via Native USB (JTAG) ----
CONFIG_ESP_CONSOLE_USB_SERIAL_JTAG=n
```
